#include "dmg_boot_intro.h"
#include "dmg_menu.h"

#include <string.h>

#include "pico/stdlib.h"
#include "pico/multicore.h"
#include "hardware/sync.h"
#include "hardware/watchdog.h"

/* One asset for the bootloader and the nine emulators: generated by
 * pico-bootLoader/tools/make_boot_anim_assets.py; included by relative path,
 * so no emulator needs an extra include directory. */
#include "../pico-bootLoader/src/boot_anim_assets.h"

/* Same timings as showBootIntro() in pico-bootLoader/main.cpp. Keep in step. */
#define INTRO_DELAY_MS    250u    /* black before the logo starts */
#define INTRO_DROP_MS     1150u   /* top edge -> centre, linear */
#define INTRO_FADEIN_MS   350u    /* fade-in at the start of the drop */
#define INTRO_HOLD_MS     1300u   /* after landing (and until the chime ends) */

#define SCREEN_H 240

static const dmg_emulator_desc_t *s_desc = NULL;
static volatile bool s_active = false;
static volatile bool s_done   = false;
static int s_lx, s_gain;

static inline uint16_t scale565(uint16_t c, int a) {
    if (a >= 256) return c;
    const int r = ((c >> 11) & 0x1F) * a >> 8;
    const int g = ((c >> 5)  & 0x3F) * a >> 8;
    const int b = ( c        & 0x1F) * a >> 8;
    return (uint16_t)((r << 11) | (g << 5) | b);
}

/* Chime: 22.05 kHz mono, upsampled to the emulators' 44.1 kHz I2S ring by
 * linear interpolation, then 50 ms of silence so the amp never stops on a
 * non-zero sample. Mirrors intro_chime_pump() in the bootloader. */
static bool chime_pump(uint32_t *frame) {
    const uint32_t total = 2u * BOOT_CHIME_LEN + 2205u;
    if (s_gain <= 0 || s_desc->audio_free == NULL || s_desc->audio_push == NULL) return false;
    int room = s_desc->audio_free();
    while (room-- > 0 && *frame < total) {
        const uint32_t k = *frame >> 1;
        int v = 0;
        if (k < BOOT_CHIME_LEN) {
            v = boot_chime[k];
            if ((*frame & 1u) && k + 1 < BOOT_CHIME_LEN) v = (v + boot_chime[k + 1]) / 2;
            v = (v * s_gain) >> 8;
        }
        s_desc->audio_push((int16_t)v, (int16_t)v);
        (*frame)++;
    }
    return *frame < total;
}

/* Send the logo columns over rows [top..bot]: the logo at (y, alpha) where it
 * covers, black elsewhere (which erases its previous position). One column per
 * call, along the panel's scan axis in landscape -- at most a 1 px vertical
 * seam instead of a diagonal tear, as in the bootloader. */
static void send_columns(int y, int a, int top, int bot) {
    uint16_t col[SCREEN_H];   /* core 1 stack: no SRAM taken from the emulator */
    if (top < 0) top = 0;
    if (bot > SCREEN_H - 1) bot = SCREEN_H - 1;
    if (top > bot) return;
    const int n = bot - top + 1;
    for (int c = 0; c < BOOT_LOGO_W; c++) {
        for (int i = 0; i < n; i++) {
            const int r = top + i - y;
            col[i] = (r >= 0 && r < BOOT_LOGO_H) ? scale565(boot_logo_565[r * BOOT_LOGO_W + c], a) : 0u;
        }
        s_desc->display.write_rect_565(s_lx + c, top, 1, n, col);
    }
}

static void intro_core1(void) {
    /* Black first, the whole panel: the GRAM survives DORMANT and reset, and
     * whatever is in it (the last game frame) must not show under the logo.
     * dmg_power's standby already blacks the GRAM before sleeping; this covers
     * any path that did not. */
    {
        uint16_t black[SCREEN_H];
        for (int i = 0; i < SCREEN_H; i++) black[i] = 0u;
        for (int x = 0; x < 320; x++) {
            s_desc->display.write_rect_565(x, 0, 1, SCREEN_H, black);
        }
    }

    const int y_end = (SCREEN_H - BOOT_LOGO_H) / 2;
    const int y_beg = -BOOT_LOGO_H;
    const uint32_t t0 = to_ms_since_boot(get_absolute_time());
    int  prev_y = -10000, prev_a = -1;
    bool landed = false, chime_on = false;
    uint32_t land_ms = 0, chime_frame = 0;

    for (;;) {
        const uint32_t t = to_ms_since_boot(get_absolute_time()) - t0;
        if (t >= INTRO_DELAY_MS) {
            const uint32_t td = t - INTRO_DELAY_MS;
            const uint32_t tc = td < INTRO_DROP_MS ? td : INTRO_DROP_MS;
            const int y = y_beg + (int)((int64_t)(y_end - y_beg) * tc / INTRO_DROP_MS);
            const int a = td >= INTRO_FADEIN_MS ? 256 : (int)(td * 256u / INTRO_FADEIN_MS);

            if (y != prev_y || a != prev_a) {
                const int top = (prev_y == -10000) ? y : (prev_y < y ? prev_y : y);
                const int bot = (prev_y == -10000 ? y : (prev_y > y ? prev_y : y)) + BOOT_LOGO_H - 1;
                send_columns(y, a, top, bot);
                prev_y = y;
                prev_a = a;
            }
            if (!landed && td >= INTRO_DROP_MS) {
                landed   = true;
                land_ms  = t;
                chime_on = true;
            }
        }
        if (chime_on) chime_on = chime_pump(&chime_frame);
        if (landed && !chime_on && t - land_ms >= INTRO_HOLD_MS) break;
        sleep_us(500);
    }

    __dmb();
    s_done = true;
    /* Parked until core 0 resets us. */
    for (;;) __wfe();
}

bool dmg_boot_intro_start(const dmg_emulator_desc_t *desc) {
    if (s_active || desc == NULL || desc->display.write_rect_565 == NULL) return false;
    s_desc = desc;

    const uint16_t wx = dmg_get_window_x();
    const uint16_t ww = dmg_get_window_w();
    s_lx = (int)wx + ((int)ww - BOOT_LOGO_W) / 2;

    static const int gains[6] = { 0, 40, 80, 130, 190, 256 };   /* VOLUME= 0..5 */
    uint8_t vol = dmg_get_global_volume();
    s_gain = gains[vol > 5 ? 5 : vol];

    s_done = false;
    __dmb();
    s_active = true;
    multicore_reset_core1();
    multicore_launch_core1(intro_core1);
    return true;
}

bool dmg_boot_intro_active(void) {
    return s_active;
}

void dmg_boot_intro_finish(void) {
    if (!s_active) return;
    while (!s_done) {
        watchdog_update();
        sleep_ms(5);
    }
    multicore_reset_core1();

    /* Let the chime's tail drain out of the audio ring: the emulator should
     * find its audio idle, as on a normal boot. The free space grows while
     * the DMA drains and stops moving once it is empty (or stalled). */
    if (s_desc->audio_free != NULL) {
        int prev = -1;
        for (int i = 0; i < 40; i++) {   /* 200 ms at most */
            const int f = s_desc->audio_free();
            if (f == prev) break;
            prev = f;
            watchdog_update();
            sleep_ms(5);
        }
    }
    s_active = false;

    /* Put the audio back exactly as the emulator runs it: rate, ring, DMA. */
    if (s_desc->audio_restore != NULL) s_desc->audio_restore();
}

/* Core 1 runs the intro from XIP, which an erase/program would pull out from
 * under it. Rather than a multicore lockout (its handler and helpers live in
 * RAM, and PicoWS has no RAM to spare), the intro is simply allowed to finish
 * first. A flash write on a resume is rare anyway: every loader compares the
 * ROM already in flash and skips the write when it matches. */
void dmg_boot_intro_flash_begin(void) {
    dmg_boot_intro_finish();
}

void dmg_boot_intro_flash_end(void) {
}
